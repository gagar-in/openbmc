## meta-gagarin/conf/layer.conf
```bitbake
# We have a conf and classes directory, add to BBPATH
BBPATH .= ":${LAYERDIR}"

# We have recipes-* directories, add to BBFILES
BBFILES += "${LAYERDIR}/recipes-*/*/*.bb \
            ${LAYERDIR}/recipes-*/*/*.bbappend \
            ${LAYERDIR}/meta-common/recipes-*/*/*.bb \
            ${LAYERDIR}/meta-common/recipes-*/*/*.bbappend"

BBFILE_COLLECTIONS += "gagarin-layer"
BBFILE_PATTERN_gagarin-layer := "^${LAYERDIR}/"
LAYERSERIES_COMPAT_gagarin-layer := "langdale mickledore"
```

## meta-gagarin/conf/machine/include/gagarin-nohost.inc
```bitbake
MACHINEOVERRIDES =. "gagarin-nohost:"

require conf/machine/include/gagarin.inc

IMAGE_FEATURES:remove = "obmc-system-mgmt"
IMAGE_FEATURES:remove = "obmc-ikvm"
```

## meta-gagarin/conf/machine/include/gagarin.inc
```bitbake
MACHINEOVERRIDES =. ":gagarin"

require conf/machine/include/gagarin_debug.inc

MACHINE_FEATURES += "\
        obmc-bmc-state-mgmt \
        obmc-phosphor-fan-mgmt \
        obmc-phosphor-flash-mgmt \
        "

VIRTUAL-RUNTIME_skeleton_workbook = "${MACHINE}-config"

PREFERRED_PROVIDER_virtual/obmc-chassis-mgmt = "packagegroup-gagarin-apps"
PREFERRED_PROVIDER_virtual/obmc-fan-mgmt = "packagegroup-gagarin-apps"
PREFERRED_PROVIDER_virtual/obmc-flash-mgmt = "packagegroup-gagarin-apps"
PREFERRED_PROVIDER_virtual/obmc-inventory-data ?= "${VIRTUAL-RUNTIME_skeleton_workbook}"
PREFERRED_PROVIDER_virtual/obmc-system-mgmt = "packagegroup-gagarin-apps"

IMAGE_FEATURES:append = " allow-root-login"

# Most of our hardware uses the default ttyS4 but at 115200.
SERIAL_CONSOLES = "115200;ttyS4"
```

## meta-gagarin/conf/machine/include/gagarin_debug.inc
```bitbake
MACHINEOVERRIDES =. "gagarin-debug:"

OBMC_IMAGE_EXTRA_INSTALL:append = " \
    strace \
    gdbserver \
    screen \
    iproute2 \
    ethtool \
    psmisc \
    tcpdump \
"

#It needs to replace dropebear on openssh to debug with Eclipse 
#OBMC_IMAGE_EXTRA_INSTALL:append = " \                                                                                                                                                                                                         
#    openssh-sftp \
#    openssh-sftp-server \                                                                                                                                                                                                                                  
#"    
#EXTRA_IMAGE_FEATURES:append := " \
#    eclipse-debug \
#    ssh-server-openssh \
#    "

BB_NUMBER_THREADS ?= "8" 
PARALLEL_MAKE ?= "-j 8"
```

## meta-gagarin/meta-tiogapass/conf/machine/gagarin-tp.conf
```bitbake
KMACHINE = "aspeed"
KERNEL_DEVICETREE = "${KMACHINE}-bmc-facebook-tiogapass.dtb"

UBOOT_DEVICETREE = "ast2500-evb"
UBOOT_MACHINE = "evb-ast2500_defconfig"

require conf/machine/include/gagarin-withhost.inc
require conf/machine/include/ast2500.inc
require conf/machine/include/obmc-bsp-common.inc

#Set SPI flash layout to 64MB
FLASH_SIZE = "65536"

PREFERRED_PROVIDER_virtual/obmc-host-ctl ?= ""
```
